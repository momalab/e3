template<class Bit> Bit gate_mux
(const Bit & a, const Bit & b, const Bit & c) noexcept
{
    return Bit::gate_mux(c,b,a);
}

template<class T, class Bit> void bsort_round
(T & current_out, T & next_out, const T & current_in, const T & next_in) noexcept
{
  current_out[7] = Bit::gate_and(current_in[7], next_in[7]);
  auto n42 = Bit::gate_not(next_in[6]);
  auto n70 = Bit::gate_nand(n42, current_in[6]);
  auto n68 = Bit::gate_xor(n42, current_in[6]);
  auto n43 = Bit::gate_not(next_in[4]);
  auto n61 = Bit::gate_nand(n43, current_in[4]);
  auto n59 = Bit::gate_xor(n43, current_in[4]);
  auto n47 = Bit::gate_nand(current_in[1], current_in[0]);
  auto n45 = Bit::gate_xor(current_in[1], current_in[0]);
  auto n44 = Bit::gate_not(next_in[1]);
  auto n46 = Bit::gate_nand(n45, n44);
  auto n48 = Bit::gate_nand(n47, n46);
  auto n52 = Bit::gate_nand(n48, current_in[2]);
  auto n50 = Bit::gate_xor(n48, current_in[2]);
  auto n49 = Bit::gate_not(next_in[2]);
  auto n51 = Bit::gate_nand(n50, n49);
  auto n53 = Bit::gate_nand(n52, n51);
  auto n57 = Bit::gate_nand(n53, current_in[3]);
  auto n55 = Bit::gate_xor(n53, current_in[3]);
  auto n54 = Bit::gate_not(next_in[3]);
  auto n56 = Bit::gate_nand(n55, n54);
  auto n58 = Bit::gate_nand(n57, n56);
  auto n60 = Bit::gate_nand(n59, n58);
  auto n62 = Bit::gate_nand(n61, n60);
  auto n66 = Bit::gate_nand(n62, current_in[5]);
  auto n64 = Bit::gate_xor(n62, current_in[5]);
  auto n63 = Bit::gate_not(next_in[5]);
  auto n65 = Bit::gate_nand(n64, n63);
  auto n67 = Bit::gate_nand(n66, n65);
  auto n69 = Bit::gate_nand(n68, n67);
  auto n71 = Bit::gate_nand(n70, n69);
  auto n74 = Bit::gate_nand(n71, current_in[7]);
  auto n72 = Bit::gate_xor(n71, current_in[7]);
  auto n75 = Bit::gate_not(next_in[7]);
  auto n73 = Bit::gate_nand(n72, n75);
  auto n77 = Bit::gate_nand(n74, n73);
  next_out[0] = gate_mux(next_in[0], current_in[0], n77);
  next_out[1] = gate_mux(next_in[1], current_in[1], n77);
  next_out[2] = gate_mux(next_in[2], current_in[2], n77);
  next_out[3] = gate_mux(next_in[3], current_in[3], n77);
  next_out[4] = gate_mux(next_in[4], current_in[4], n77);
  next_out[5] = gate_mux(next_in[5], current_in[5], n77);
  next_out[6] = gate_mux(next_in[6], current_in[6], n77);
  auto n76 = Bit::gate_not(current_in[7]);
  next_out[7] = Bit::gate_nand(n76, n75);
  current_out[0] = gate_mux(current_in[0], next_in[0], n77);
  current_out[1] = gate_mux(current_in[1], next_in[1], n77);
  current_out[2] = gate_mux(current_in[2], next_in[2], n77);
  current_out[3] = gate_mux(current_in[3], next_in[3], n77);
  current_out[4] = gate_mux(current_in[4], next_in[4], n77);
  current_out[5] = gate_mux(current_in[5], next_in[5], n77);
  current_out[6] = gate_mux(current_in[6], next_in[6], n77);
}
template<class T, class Bit> void fact_round
(T & res_out, T & i_out, T & fact_out, const T & n, const T & res_in, const T & i_in, const T & fact_in) noexcept
{
  auto n33 = Bit::gate_xnor(n[5], i_in[5]);
  auto n35 = Bit::gate_xnor(n[3], i_in[3]);
  auto n51 = Bit::gate_xnor(n[1], i_in[1]);
  auto n54 = Bit::gate_and(i_in[3], fact_in[2]);
  auto n57 = Bit::gate_and(i_in[2], fact_in[4]);
  auto n58 = Bit::gate_and(i_in[2], fact_in[2]);
  auto n60 = Bit::gate_and(i_in[2], fact_in[0]);
  auto n61 = Bit::gate_and(i_in[0], i_in[1]);
  auto n62 = Bit::gate_and(i_in[1], fact_in[3]);
  auto n63 = Bit::gate_and(i_in[1], fact_in[0]);
  auto n64 = Bit::gate_and(i_in[0], fact_in[4]);
  auto n65 = Bit::gate_and(i_in[0], fact_in[2]);
  auto n66 = Bit::gate_and(i_in[0], fact_in[1]);
  fact_out[0] = Bit::gate_and(i_in[0], fact_in[0]);
  i_out[0] = Bit::gate_not(i_in[0]);
  auto n72 = Bit::gate_xor(i_out[0], n[0]);
  auto n168 = Bit::gate_not(i_in[2]);
  auto n71 = Bit::gate_xor(n168, n[2]);
  auto n226 = Bit::gate_not(i_in[4]);
  auto n70 = Bit::gate_xor(n226, n[4]);
  auto n233 = Bit::gate_not(i_in[7]);
  auto n69 = Bit::gate_xor(n233, n[7]);
  auto n229 = Bit::gate_not(i_in[6]);
  auto n68 = Bit::gate_xor(n229, n[6]);
  fact_out[1] = Bit::gate_xor(n66, n63);
  auto n92 = Bit::gate_nand(i_in[1], fact_in[1]);
  auto n76 = Bit::gate_not(n92);
  auto n80 = Bit::gate_xor(n76, n60);
  auto n81 = Bit::gate_xor(n65, n80);
  auto n79 = Bit::gate_nand(i_in[3], fact_in[0]);
  auto n77 = Bit::gate_nand(n76, n60);
  auto n88 = Bit::gate_nand(i_in[0], fact_in[3]);
  auto n89 = Bit::gate_nand(i_in[1], fact_in[2]);
  auto n94 = Bit::gate_xor(n88, n89);
  auto n83 = Bit::gate_nand(n65, n80);
  auto n91 = Bit::gate_not(n88);
  auto n90 = Bit::gate_not(n89);
  auto n112 = Bit::gate_xor(n64, n62);
  auto n105 = Bit::gate_nand(i_in[3], fact_in[1]);
  auto n93 = Bit::gate_nand(n92, n105);
  auto n106 = Bit::gate_nand(i_in[4], fact_in[0]);
  auto n109 = Bit::gate_xor(n105, n106);
  auto n116 = Bit::gate_xor(n109, n58);
  auto n147 = Bit::gate_nand(n64, n62);
  auto n104 = Bit::gate_nand(fact_in[3], i_in[2]);
  auto n146 = Bit::gate_xor(n147, n104);
  auto n126 = Bit::gate_nand(i_in[0], fact_in[5]);
  auto n127 = Bit::gate_nand(i_in[1], fact_in[4]);
  auto n145 = Bit::gate_xor(n126, n127);
  auto n133 = Bit::gate_xor(n146, n145);
  auto n138 = Bit::gate_nand(i_in[4], fact_in[1]);
  auto n139 = Bit::gate_nand(i_in[5], fact_in[0]);
  auto n142 = Bit::gate_xor(n138, n139);
  auto n131 = Bit::gate_xor(n54, n142);
  auto n108 = Bit::gate_not(n105);
  auto n107 = Bit::gate_not(n106);
  auto n111 = Bit::gate_nand(n108, n107);
  auto n110 = Bit::gate_nand(n109, n58);
  auto n130 = Bit::gate_nand(n111, n110);
  auto n132 = Bit::gate_xor(n131, n130);
  auto n152 = Bit::gate_xor(n133, n132);
  auto n194 = Bit::gate_nand(i_in[3], fact_in[3]);
  auto n195 = Bit::gate_nand(i_in[4], fact_in[2]);
  auto n193 = Bit::gate_xor(n194, n195);
  auto n129 = Bit::gate_not(n126);
  auto n128 = Bit::gate_not(n127);
  auto n184 = Bit::gate_nand(i_in[5], fact_in[1]);
  auto n185 = Bit::gate_nand(i_in[6], fact_in[0]);
  auto n188 = Bit::gate_xor(n184, n185);
  auto n213 = Bit::gate_xor(n188, n57);
  auto n135 = Bit::gate_nand(n131, n130);
  auto n134 = Bit::gate_nand(n133, n132);
  auto n214 = Bit::gate_nand(n135, n134);
  auto n137 = Bit::gate_nand(fact_in[5], i_in[1]);
  auto n136 = Bit::gate_nand(fact_in[6], i_in[0]);
  auto n203 = Bit::gate_xor(n137, n136);
  auto n141 = Bit::gate_not(n138);
  auto n140 = Bit::gate_not(n139);
  auto n144 = Bit::gate_nand(n141, n140);
  auto n143 = Bit::gate_nand(n54, n142);
  auto n202 = Bit::gate_nand(n144, n143);
  auto n205 = Bit::gate_xor(n203, n202);
  auto n150 = Bit::gate_nand(n146, n145);
  auto n148 = Bit::gate_not(n147);
  auto n149 = Bit::gate_nand(n148, i_in[2]);
  auto n204 = Bit::gate_nand(n150, n149);
  auto n162 = Bit::gate_xor(n205, n204);
  auto n167 = Bit::gate_nand(n61, fact_in[6]);
  auto n169 = Bit::gate_xor(n168, n167);
  auto n181 = Bit::gate_nand(fact_in[5], n169);
  auto n171 = Bit::gate_nand(fact_in[0], i_in[7]);
  auto n170 = Bit::gate_nand(fact_in[4], i_in[3]);
  auto n179 = Bit::gate_xor(n171, n170);
  auto n173 = Bit::gate_nand(fact_in[6], i_in[1]);
  auto n172 = Bit::gate_nand(fact_in[7], i_in[0]);
  auto n177 = Bit::gate_xor(n173, n172);
  auto n175 = Bit::gate_nand(fact_in[2], i_in[5]);
  auto n174 = Bit::gate_nand(fact_in[3], i_in[4]);
  auto n176 = Bit::gate_xor(n175, n174);
  auto n178 = Bit::gate_xor(n177, n176);
  auto n180 = Bit::gate_xor(n179, n178);
  auto n183 = Bit::gate_xor(n181, n180);
  auto n182 = Bit::gate_nand(fact_in[1], i_in[6]);
  auto n192 = Bit::gate_xor(n183, n182);
  auto n187 = Bit::gate_not(n184);
  auto n186 = Bit::gate_not(n185);
  auto n190 = Bit::gate_nand(n187, n186);
  auto n189 = Bit::gate_nand(n188, n57);
  auto n191 = Bit::gate_nand(n190, n189);
  auto n201 = Bit::gate_xor(n192, n191);
  auto n197 = Bit::gate_not(n194);
  auto n196 = Bit::gate_not(n195);
  auto n198 = Bit::gate_nand(n197, n196);
  auto n207 = Bit::gate_nand(n203, n202);
  auto n206 = Bit::gate_nand(n205, n204);
  auto n208 = Bit::gate_nand(n207, n206);
  i_out[1] = Bit::gate_xor(i_in[0], i_in[1]);
  i_out[2] = Bit::gate_xor(i_in[2], n61);
  auto n31 = Bit::gate_and(n69, n68);
  auto n32 = Bit::gate_and(n129, n128);
  auto n34 = Bit::gate_and(n91, n90);
  auto n41 = Bit::gate_and(n31, n33);
  auto n47 = Bit::gate_and(n66, n63);
  auto n50 = Bit::gate_and(n70, n41);
  auto n55 = Bit::gate_and(n93, n60);
  auto n56 = Bit::gate_and(i_in[2], n61);
  auto n59 = Bit::gate_and(i_in[2], n77);
  fact_out[2] = Bit::gate_xor(n47, n81);
  auto n78 = Bit::gate_nand(fact_in[1], n59);
  auto n95 = Bit::gate_xor(n79, n78);
  auto n97 = Bit::gate_xor(n95, n94);
  auto n82 = Bit::gate_nand(n47, n81);
  auto n96 = Bit::gate_nand(n83, n82);
  fact_out[3] = Bit::gate_xor(n97, n96);
  auto n113 = Bit::gate_xor(n34, n112);
  auto n117 = Bit::gate_xor(n113, n55);
  auto n119 = Bit::gate_xor(n117, n116);
  auto n99 = Bit::gate_nand(n95, n94);
  auto n98 = Bit::gate_nand(n97, n96);
  auto n118 = Bit::gate_nand(n99, n98);
  fact_out[4] = Bit::gate_xor(n119, n118);
  auto n115 = Bit::gate_nand(n34, n112);
  auto n114 = Bit::gate_nand(n113, n55);
  auto n151 = Bit::gate_nand(n115, n114);
  auto n154 = Bit::gate_xor(n152, n151);
  auto n121 = Bit::gate_nand(n117, n116);
  auto n120 = Bit::gate_nand(n119, n118);
  auto n153 = Bit::gate_nand(n121, n120);
  fact_out[5] = Bit::gate_xor(n154, n153);
  auto n212 = Bit::gate_xor(n193, n32);
  auto n215 = Bit::gate_xor(n212, n213);
  auto n161 = Bit::gate_xor(n215, n214);
  auto n164 = Bit::gate_xor(n161, n162);
  auto n156 = Bit::gate_nand(n152, n151);
  auto n155 = Bit::gate_nand(n154, n153);
  auto n163 = Bit::gate_nand(n156, n155);
  fact_out[6] = Bit::gate_xor(n164, n163);
  auto n166 = Bit::gate_nand(n162, n161);
  auto n165 = Bit::gate_nand(n164, n163);
  auto n211 = Bit::gate_nand(n166, n165);
  auto n199 = Bit::gate_nand(n32, n193);
  auto n200 = Bit::gate_nand(n199, n198);
  auto n209 = Bit::gate_xor(n201, n200);
  auto n210 = Bit::gate_xor(n209, n208);
  auto n219 = Bit::gate_xor(n211, n210);
  auto n217 = Bit::gate_nand(n213, n212);
  auto n216 = Bit::gate_nand(n215, n214);
  auto n218 = Bit::gate_nand(n217, n216);
  fact_out[7] = Bit::gate_xor(n219, n218);
  i_out[3] = Bit::gate_xor(i_in[3], n56);
  auto n227 = Bit::gate_nand(i_in[3], n56);
  i_out[4] = Bit::gate_xor(n226, n227);
  auto n228 = Bit::gate_not(n227);
  auto n44 = Bit::gate_and(n50, n35);
  auto n45 = Bit::gate_and(n71, n44);
  auto n53 = Bit::gate_and(i_in[4], n228);
  i_out[5] = Bit::gate_xor(i_in[5], n53);
  auto n230 = Bit::gate_nand(i_in[5], n53);
  i_out[6] = Bit::gate_xor(n229, n230);
  auto n231 = Bit::gate_not(n230);
  auto n232 = Bit::gate_nand(i_in[6], n231);
  i_out[7] = Bit::gate_xor(n233, n232);
  auto n43 = Bit::gate_and(n45, n51);
  auto n52 = Bit::gate_and(n72, n43);
  auto n220 = Bit::gate_nand(n52, fact_out[7]);
  auto n36 = Bit::gate_and(n52, fact_out[6]);
  auto n37 = Bit::gate_xnor(res_in[7], n220);
  auto n38 = Bit::gate_and(n52, fact_out[4]);
  auto n40 = Bit::gate_and(n52, fact_out[2]);
  auto n42 = Bit::gate_and(n52, fact_out[0]);
  auto n46 = Bit::gate_and(n52, fact_out[1]);
  auto n48 = Bit::gate_and(n52, fact_out[5]);
  auto n49 = Bit::gate_and(n52, fact_out[3]);
  res_out[0] = Bit::gate_xor(n42, res_in[0]);
  auto n73 = Bit::gate_xor(n46, res_in[1]);
  auto n85 = Bit::gate_xor(res_in[2], n40);
  auto n75 = Bit::gate_nand(n46, res_in[1]);
  auto n101 = Bit::gate_xor(res_in[3], n49);
  auto n87 = Bit::gate_nand(res_in[2], n40);
  auto n123 = Bit::gate_xor(res_in[4], n38);
  auto n103 = Bit::gate_nand(res_in[3], n49);
  auto n158 = Bit::gate_xor(res_in[5], n48);
  auto n125 = Bit::gate_nand(res_in[4], n38);
  auto n222 = Bit::gate_xor(res_in[6], n36);
  auto n160 = Bit::gate_nand(res_in[5], n48);
  auto n224 = Bit::gate_nand(res_in[6], n36);
  auto n39 = Bit::gate_and(n42, res_in[0]);
  res_out[1] = Bit::gate_xor(n39, n73);
  auto n74 = Bit::gate_nand(n39, n73);
  auto n84 = Bit::gate_nand(n75, n74);
  res_out[2] = Bit::gate_xor(n85, n84);
  auto n86 = Bit::gate_nand(n85, n84);
  auto n100 = Bit::gate_nand(n87, n86);
  res_out[3] = Bit::gate_xor(n101, n100);
  auto n102 = Bit::gate_nand(n101, n100);
  auto n122 = Bit::gate_nand(n103, n102);
  res_out[4] = Bit::gate_xor(n123, n122);
  auto n124 = Bit::gate_nand(n123, n122);
  auto n157 = Bit::gate_nand(n125, n124);
  res_out[5] = Bit::gate_xor(n158, n157);
  auto n159 = Bit::gate_nand(n158, n157);
  auto n221 = Bit::gate_nand(n160, n159);
  res_out[6] = Bit::gate_xor(n222, n221);
  auto n223 = Bit::gate_nand(n222, n221);
  auto n225 = Bit::gate_nand(n224, n223);
  res_out[7] = Bit::gate_xor(n37, n225);
}
template<class T, class Bit> void fib_round
(T & res_out, T & i_out, T & fi_out, T & f1_out, const T & n, const T & res_in, const T & i_in, const T & fi_in, const T & f1_in) noexcept
{
  f1_out[7] = Bit::gate_buf(fi_in[7]);
  f1_out[6] = Bit::gate_buf(fi_in[6]);
  f1_out[5] = Bit::gate_buf(fi_in[5]);
  f1_out[4] = Bit::gate_buf(fi_in[4]);
  f1_out[3] = Bit::gate_buf(fi_in[3]);
  f1_out[2] = Bit::gate_buf(fi_in[2]);
  f1_out[1] = Bit::gate_buf(fi_in[1]);
  f1_out[0] = Bit::gate_buf(fi_in[0]);
  auto n39 = Bit::gate_xnor(i_in[6], n[6]);
  auto n46 = Bit::gate_xnor(i_in[4], n[4]);
  auto n47 = Bit::gate_and(i_in[0], i_in[1]);
  auto n48 = Bit::gate_and(i_in[2], n47);
  auto n49 = Bit::gate_and(i_in[3], n48);
  auto n50 = Bit::gate_and(i_in[4], n49);
  auto n51 = Bit::gate_and(i_in[5], n50);
  auto n53 = Bit::gate_xnor(i_in[1], n[1]);
  auto n54 = Bit::gate_xnor(i_in[2], n[2]);
  auto n55 = Bit::gate_xnor(i_in[3], n[3]);
  auto n56 = Bit::gate_xnor(i_in[5], n[5]);
  auto n58 = Bit::gate_and(f1_out[0], f1_in[0]);
  fi_out[0] = Bit::gate_xor(f1_out[0], f1_in[0]);
  auto n59 = Bit::gate_xor(f1_out[1], f1_in[1]);
  fi_out[1] = Bit::gate_xor(n59, n58);
  auto n63 = Bit::gate_xor(f1_out[2], f1_in[2]);
  auto n61 = Bit::gate_nand(f1_out[1], f1_in[1]);
  auto n60 = Bit::gate_nand(n59, n58);
  auto n62 = Bit::gate_nand(n61, n60);
  fi_out[2] = Bit::gate_xor(n63, n62);
  auto n67 = Bit::gate_xor(f1_out[3], f1_in[3]);
  auto n65 = Bit::gate_nand(f1_out[2], f1_in[2]);
  auto n64 = Bit::gate_nand(n63, n62);
  auto n66 = Bit::gate_nand(n65, n64);
  fi_out[3] = Bit::gate_xor(n67, n66);
  auto n71 = Bit::gate_xor(f1_out[4], f1_in[4]);
  auto n69 = Bit::gate_nand(f1_out[3], f1_in[3]);
  auto n68 = Bit::gate_nand(n67, n66);
  auto n70 = Bit::gate_nand(n69, n68);
  fi_out[4] = Bit::gate_xor(n71, n70);
  auto n75 = Bit::gate_xor(f1_out[5], f1_in[5]);
  auto n73 = Bit::gate_nand(f1_out[4], f1_in[4]);
  auto n72 = Bit::gate_nand(n71, n70);
  auto n74 = Bit::gate_nand(n73, n72);
  fi_out[5] = Bit::gate_xor(n75, n74);
  auto n79 = Bit::gate_xor(f1_out[6], f1_in[6]);
  auto n77 = Bit::gate_nand(f1_out[5], f1_in[5]);
  auto n76 = Bit::gate_nand(n75, n74);
  auto n78 = Bit::gate_nand(n77, n76);
  fi_out[6] = Bit::gate_xor(n79, n78);
  auto n81 = Bit::gate_nand(n79, n78);
  auto n80 = Bit::gate_nand(f1_out[6], f1_in[6]);
  auto n82 = Bit::gate_nand(n81, n80);
  auto n83 = Bit::gate_xor(f1_in[7], n82);
  fi_out[7] = Bit::gate_xor(f1_out[7], n83);
  i_out[0] = Bit::gate_not(i_in[0]);
  auto n114 = Bit::gate_not(i_in[7]);
  auto n84 = Bit::gate_xor(n114, n[7]);
  auto n85 = Bit::gate_xor(i_out[0], n[0]);
  auto n106 = Bit::gate_not(res_in[7]);
  i_out[1] = Bit::gate_xor(i_in[0], i_in[1]);
  i_out[2] = Bit::gate_xor(i_in[2], n47);
  i_out[3] = Bit::gate_xor(i_in[3], n48);
  i_out[4] = Bit::gate_xor(i_in[4], n49);
  i_out[5] = Bit::gate_xor(i_in[5], n50);
  i_out[6] = Bit::gate_xor(i_in[6], n51);
  auto n113 = Bit::gate_nand(i_in[6], n51);
  i_out[7] = Bit::gate_xor(n114, n113);
  auto n32 = Bit::gate_and(n84, n39);
  auto n35 = Bit::gate_and(n53, n85);
  auto n36 = Bit::gate_and(n55, n54);
  auto n37 = Bit::gate_and(n56, n46);
  auto n38 = Bit::gate_and(n32, n35);
  auto n33 = Bit::gate_and(n37, n36);
  auto n34 = Bit::gate_and(n38, n33);
  auto n40 = Bit::gate_and(n34, f1_out[1]);
  auto n41 = Bit::gate_and(n34, f1_out[2]);
  auto n42 = Bit::gate_and(n34, f1_out[3]);
  auto n43 = Bit::gate_and(n34, f1_out[4]);
  auto n44 = Bit::gate_and(n34, f1_out[5]);
  auto n45 = Bit::gate_and(n34, f1_out[6]);
  auto n57 = Bit::gate_and(n34, f1_out[0]);
  res_out[0] = Bit::gate_xor(n57, res_in[0]);
  auto n86 = Bit::gate_xor(n40, res_in[1]);
  auto n90 = Bit::gate_xor(n41, res_in[2]);
  auto n88 = Bit::gate_nand(n40, res_in[1]);
  auto n94 = Bit::gate_xor(n42, res_in[3]);
  auto n92 = Bit::gate_nand(n41, res_in[2]);
  auto n98 = Bit::gate_xor(n43, res_in[4]);
  auto n96 = Bit::gate_nand(n42, res_in[3]);
  auto n102 = Bit::gate_xor(n44, res_in[5]);
  auto n100 = Bit::gate_nand(n43, res_in[4]);
  auto n108 = Bit::gate_xor(n45, res_in[6]);
  auto n104 = Bit::gate_nand(n44, res_in[5]);
  auto n105 = Bit::gate_nand(f1_out[7], n34);
  auto n112 = Bit::gate_xor(n106, n105);
  auto n110 = Bit::gate_nand(n45, res_in[6]);
  auto n52 = Bit::gate_and(n57, res_in[0]);
  res_out[1] = Bit::gate_xor(n86, n52);
  auto n87 = Bit::gate_nand(n86, n52);
  auto n89 = Bit::gate_nand(n88, n87);
  res_out[2] = Bit::gate_xor(n90, n89);
  auto n91 = Bit::gate_nand(n90, n89);
  auto n93 = Bit::gate_nand(n92, n91);
  res_out[3] = Bit::gate_xor(n94, n93);
  auto n95 = Bit::gate_nand(n94, n93);
  auto n97 = Bit::gate_nand(n96, n95);
  res_out[4] = Bit::gate_xor(n98, n97);
  auto n99 = Bit::gate_nand(n98, n97);
  auto n101 = Bit::gate_nand(n100, n99);
  res_out[5] = Bit::gate_xor(n102, n101);
  auto n103 = Bit::gate_nand(n102, n101);
  auto n107 = Bit::gate_nand(n104, n103);
  res_out[6] = Bit::gate_xor(n108, n107);
  auto n109 = Bit::gate_nand(n108, n107);
  auto n111 = Bit::gate_nand(n110, n109);
  res_out[7] = Bit::gate_xor(n112, n111);
}
template<class T, class Bit> void isort_round
(T & previous_out, T & current_out, const T & previous_in, const T & current_in) noexcept
{
  previous_out[7] = Bit::gate_and(current_in[7], previous_in[7]);
  auto n43 = Bit::gate_not(current_in[6]);
  auto n72 = Bit::gate_nand(n43, previous_in[6]);
  auto n70 = Bit::gate_xor(n43, previous_in[6]);
  auto n44 = Bit::gate_not(current_in[3]);
  auto n58 = Bit::gate_nand(n44, previous_in[3]);
  auto n56 = Bit::gate_xor(n44, previous_in[3]);
  auto n45 = Bit::gate_not(current_in[2]);
  auto n54 = Bit::gate_nand(n45, previous_in[2]);
  auto n52 = Bit::gate_xor(n45, previous_in[2]);
  auto n46 = Bit::gate_not(current_in[1]);
  auto n50 = Bit::gate_nand(n46, previous_in[1]);
  auto n48 = Bit::gate_xor(n46, previous_in[1]);
  auto n47 = Bit::gate_not(current_in[0]);
  auto n49 = Bit::gate_nand(n48, n47);
  auto n51 = Bit::gate_nand(n50, n49);
  auto n53 = Bit::gate_nand(n52, n51);
  auto n55 = Bit::gate_nand(n54, n53);
  auto n57 = Bit::gate_nand(n56, n55);
  auto n59 = Bit::gate_nand(n58, n57);
  auto n63 = Bit::gate_nand(n59, previous_in[4]);
  auto n61 = Bit::gate_xor(n59, previous_in[4]);
  auto n60 = Bit::gate_not(current_in[4]);
  auto n62 = Bit::gate_nand(n61, n60);
  auto n64 = Bit::gate_nand(n63, n62);
  auto n68 = Bit::gate_nand(n64, previous_in[5]);
  auto n66 = Bit::gate_xor(n64, previous_in[5]);
  auto n65 = Bit::gate_not(current_in[5]);
  auto n67 = Bit::gate_nand(n66, n65);
  auto n69 = Bit::gate_nand(n68, n67);
  auto n71 = Bit::gate_nand(n70, n69);
  auto n73 = Bit::gate_nand(n72, n71);
  auto n76 = Bit::gate_nand(n73, previous_in[7]);
  auto n74 = Bit::gate_xor(n73, previous_in[7]);
  auto n78 = Bit::gate_not(current_in[7]);
  auto n75 = Bit::gate_nand(n74, n78);
  auto n79 = Bit::gate_nand(n76, n75);
  current_out[0] = gate_mux(current_in[0], previous_in[0], n79);
  current_out[1] = gate_mux(current_in[1], previous_in[1], n79);
  current_out[2] = gate_mux(current_in[2], previous_in[2], n79);
  current_out[3] = gate_mux(current_in[3], previous_in[3], n79);
  current_out[4] = gate_mux(current_in[4], previous_in[4], n79);
  current_out[5] = gate_mux(current_in[5], previous_in[5], n79);
  current_out[6] = gate_mux(current_in[6], previous_in[6], n79);
  auto n77 = Bit::gate_not(previous_in[7]);
  current_out[7] = Bit::gate_nand(n78, n77);
  previous_out[0] = gate_mux(previous_in[0], current_in[0], n79);
  previous_out[1] = gate_mux(previous_in[1], current_in[1], n79);
  previous_out[2] = gate_mux(previous_in[2], current_in[2], n79);
  previous_out[3] = gate_mux(previous_in[3], current_in[3], n79);
  previous_out[4] = gate_mux(previous_in[4], current_in[4], n79);
  previous_out[5] = gate_mux(previous_in[5], current_in[5], n79);
  previous_out[6] = gate_mux(previous_in[6], current_in[6], n79);
}
template<class T, class Bit> void jen_end
(T & hash_out, const T & hash_in, const T & n3, const T & n11, const T & n15) noexcept
{
  auto n162 = Bit::gate_and(n15[1], n15[0]);
  auto n164 = Bit::gate_and(n3[1], n3[0]);
  auto n253 = Bit::gate_not(n3[1]);
  auto n255 = Bit::gate_not(n3[0]);
  auto n211 = Bit::gate_not(n3[3]);
  auto n210 = Bit::gate_not(n3[4]);
  auto n213 = Bit::gate_not(n3[5]);
  auto n212 = Bit::gate_not(n3[6]);
  auto n214 = Bit::gate_not(n3[7]);
  auto n215 = Bit::gate_not(n3[2]);
  auto n217 = Bit::gate_not(n11[3]);
  auto n216 = Bit::gate_not(n11[4]);
  auto n219 = Bit::gate_not(n11[5]);
  auto n218 = Bit::gate_not(n11[6]);
  auto n220 = Bit::gate_not(n11[7]);
  auto n256 = Bit::gate_not(hash_in[2]);
  auto n235 = gate_mux(hash_in[2], hash_in[0], n3[1]);
  auto n221 = gate_mux(hash_in[1], hash_in[0], n3[0]);
  auto n234 = gate_mux(hash_in[3], hash_in[1], n3[1]);
  auto n237 = Bit::gate_nand(n234, n255);
  auto n236 = Bit::gate_nand(n3[0], n235);
  auto n277 = Bit::gate_nand(n237, n236);
  auto n239 = gate_mux(hash_in[4], hash_in[6], n253);
  auto n240 = Bit::gate_not(n239);
  auto n243 = Bit::gate_nand(n240, n255);
  auto n254 = Bit::gate_not(hash_in[3]);
  auto n252 = Bit::gate_not(hash_in[5]);
  auto n241 = gate_mux(n254, n252, n253);
  auto n242 = Bit::gate_nand(n3[0], n241);
  auto n246 = gate_mux(n256, n254, n255);
  auto n249 = Bit::gate_nand(n3[1], n246);
  auto n260 = Bit::gate_not(hash_in[4]);
  auto n274 = gate_mux(n252, n260, n3[0]);
  auto n247 = Bit::gate_nand(n274, n253);
  auto n259 = Bit::gate_not(hash_in[1]);
  auto n263 = Bit::gate_nand(n164, n259);
  auto n276 = gate_mux(hash_in[7], hash_in[6], n3[0]);
  auto n275 = Bit::gate_not(n274);
  auto n278 = gate_mux(n276, n275, n3[1]);
  auto n279 = gate_mux(n278, n277, n3[2]);
  auto n329 = Bit::gate_not(n11[1]);
  auto n287 = Bit::gate_not(n11[0]);
  auto n383 = Bit::gate_not(n15[1]);
  auto n381 = Bit::gate_not(n15[0]);
  auto n297 = Bit::gate_not(n15[3]);
  auto n296 = Bit::gate_not(n15[4]);
  auto n299 = Bit::gate_not(n15[5]);
  auto n298 = Bit::gate_not(n15[6]);
  auto n300 = Bit::gate_not(n15[7]);
  auto n301 = Bit::gate_not(n15[2]);
  auto n346 = Bit::gate_not(n11[2]);
  auto n159 = Bit::gate_and(n243, n242);
  auto n163 = Bit::gate_and(n15[1], n381);
  auto n165 = Bit::gate_and(n3[1], n255);
  auto n173 = Bit::gate_and(n253, n221);
  auto n174 = Bit::gate_and(hash_in[1], n253);
  auto n182 = Bit::gate_and(n15[0], n383);
  auto n183 = Bit::gate_and(n297, n296);
  auto n186 = Bit::gate_and(n383, n381);
  auto n188 = Bit::gate_and(n217, n216);
  auto n189 = Bit::gate_and(n219, n218);
  auto n190 = Bit::gate_and(n3[0], n253);
  auto n191 = Bit::gate_and(n253, n255);
  auto n193 = Bit::gate_and(n211, n210);
  auto n194 = Bit::gate_and(n213, n212);
  auto n205 = Bit::gate_and(n299, n298);
  auto n206 = Bit::gate_and(n329, n287);
  auto n244 = gate_mux(n235, n174, n3[0]);
  auto n245 = gate_mux(n159, n244, n3[2]);
  auto n248 = gate_mux(n247, n173, n3[2]);
  auto n258 = Bit::gate_nand(n190, n254);
  auto n257 = Bit::gate_nand(n165, n256);
  auto n261 = Bit::gate_nand(n191, n260);
  auto n157 = Bit::gate_and(hash_in[0], n191);
  auto n158 = Bit::gate_and(n188, n189);
  auto n166 = Bit::gate_and(n249, n248);
  auto n179 = Bit::gate_and(n193, n194);
  auto n195 = Bit::gate_and(n179, n214);
  auto n199 = Bit::gate_and(n258, n257);
  auto n204 = Bit::gate_and(n183, n205);
  auto n207 = Bit::gate_and(n158, n220);
  auto n208 = Bit::gate_and(n195, n215);
  auto n225 = Bit::gate_nand(n157, n208);
  auto n295 = Bit::gate_nand(hash_in[0], n225);
  auto n227 = Bit::gate_nand(n208, n244);
  auto n230 = Bit::gate_xor(n256, n227);
  auto n224 = Bit::gate_nand(n173, n208);
  auto n222 = Bit::gate_not(n224);
  auto n229 = Bit::gate_nand(hash_in[1], n222);
  auto n322 = Bit::gate_xor(n230, n229);
  auto n223 = gate_mux(n295, n322, n11[1]);
  auto n238 = Bit::gate_not(n223);
  auto n226 = Bit::gate_xor(hash_in[1], n224);
  auto n310 = Bit::gate_nand(n226, n225);
  auto n228 = Bit::gate_not(n227);
  auto n233 = Bit::gate_nand(hash_in[2], n228);
  auto n231 = Bit::gate_not(n229);
  auto n232 = Bit::gate_nand(n231, n230);
  auto n264 = Bit::gate_nand(n233, n232);
  auto n251 = Bit::gate_nand(n195, n166);
  auto n250 = Bit::gate_not(n251);
  auto n271 = Bit::gate_nand(hash_in[5], n250);
  auto n273 = Bit::gate_xor(n252, n251);
  auto n262 = gate_mux(n261, n157, n3[2]);
  auto n302 = Bit::gate_nand(n329, n322);
  auto n315 = Bit::gate_nand(n206, n322);
  auto n160 = Bit::gate_and(n208, n277);
  auto n161 = Bit::gate_and(n195, n245);
  auto n171 = Bit::gate_and(n279, n195);
  auto n185 = Bit::gate_and(n204, n300);
  auto n187 = Bit::gate_and(n207, n346);
  auto n209 = Bit::gate_and(n263, n262);
  auto n265 = Bit::gate_xor(hash_in[3], n160);
  auto n317 = Bit::gate_xor(n264, n265);
  auto n303 = gate_mux(n310, n317, n11[1]);
  auto n292 = gate_mux(n238, n303, n11[0]);
  auto n281 = Bit::gate_xor(hash_in[6], n161);
  auto n267 = Bit::gate_nand(hash_in[3], n160);
  auto n266 = Bit::gate_nand(n265, n264);
  auto n289 = Bit::gate_nand(n267, n266);
  auto n283 = Bit::gate_nand(hash_in[6], n161);
  auto n334 = Bit::gate_not(n317);
  auto n318 = Bit::gate_nand(n334, n346);
  auto n398 = Bit::gate_nand(n187, n206);
  auto n180 = Bit::gate_and(n209, n195);
  auto n184 = Bit::gate_and(n185, n301);
  auto n196 = Bit::gate_and(n199, n180);
  auto n269 = Bit::gate_nand(hash_in[4], n196);
  auto n288 = Bit::gate_xor(hash_in[4], n196);
  auto n268 = Bit::gate_nand(n288, n289);
  auto n272 = Bit::gate_nand(n269, n268);
  auto n270 = Bit::gate_nand(n273, n272);
  auto n280 = Bit::gate_nand(n271, n270);
  auto n379 = Bit::gate_xor(n281, n280);
  auto n326 = Bit::gate_nand(n379, n11[1]);
  auto n365 = Bit::gate_xor(n273, n272);
  auto n282 = Bit::gate_nand(n281, n280);
  auto n284 = Bit::gate_nand(n283, n282);
  auto n285 = Bit::gate_xor(n171, n284);
  auto n399 = Bit::gate_xor(n285, hash_in[7]);
  auto n286 = gate_mux(n365, n399, n11[1]);
  auto n305 = Bit::gate_not(n286);
  auto n291 = gate_mux(n326, n305, n11[0]);
  auto n324 = Bit::gate_xor(n289, n288);
  auto n290 = Bit::gate_nand(n206, n324);
  auto n347 = Bit::gate_nand(n291, n290);
  auto n293 = gate_mux(n292, n347, n11[2]);
  auto n294 = Bit::gate_nand(n207, n293);
  auto n323 = Bit::gate_xor(n295, n294);
  auto n349 = Bit::gate_not(n324);
  auto n319 = Bit::gate_nand(n11[1], n349);
  auto n304 = Bit::gate_nand(n379, n329);
  auto n306 = gate_mux(n305, n304, n11[0]);
  auto n363 = Bit::gate_not(n306);
  auto n314 = gate_mux(n379, n399, n11[0]);
  auto n328 = gate_mux(n318, n365, n11[1]);
  auto n320 = gate_mux(n319, n328, n11[0]);
  auto n325 = Bit::gate_nand(n324, n329);
  auto n327 = Bit::gate_nand(n326, n325);
  auto n330 = Bit::gate_nand(n329, n399);
  auto n331 = Bit::gate_nand(n11[2], n330);
  auto n348 = Bit::gate_nand(n187, n347);
  auto n373 = Bit::gate_xor(n349, n348);
  auto n380 = Bit::gate_not(n373);
  auto n350 = Bit::gate_nand(n186, n380);
  auto n364 = Bit::gate_nand(n363, n187);
  auto n390 = Bit::gate_xor(n365, n364);
  auto n400 = gate_mux(n380, n390, n381);
  auto n369 = Bit::gate_nand(n400, n383);
  auto n393 = Bit::gate_not(n390);
  auto n416 = Bit::gate_nand(n399, n398);
  auto n168 = Bit::gate_and(n327, n346);
  auto n169 = Bit::gate_and(n207, n331);
  auto n170 = Bit::gate_and(n329, n314);
  auto n172 = Bit::gate_and(n302, n319);
  auto n177 = Bit::gate_and(n323, n186);
  auto n313 = Bit::gate_nand(n177, n184);
  auto n307 = gate_mux(n303, n172, n11[0]);
  auto n308 = gate_mux(n307, n363, n11[2]);
  auto n309 = Bit::gate_nand(n207, n308);
  auto n354 = Bit::gate_xor(n310, n309);
  auto n335 = Bit::gate_not(n354);
  auto n311 = gate_mux(n335, n323, n15[0]);
  auto n316 = gate_mux(n315, n170, n11[2]);
  auto n332 = gate_mux(n328, n168, n11[0]);
  auto n333 = Bit::gate_nand(n332, n169);
  auto n358 = Bit::gate_xor(n334, n333);
  auto n384 = Bit::gate_not(n358);
  auto n336 = gate_mux(n358, n335, n15[1]);
  auto n339 = Bit::gate_nand(n336, n381);
  auto n352 = Bit::gate_nand(n182, n384);
  auto n351 = gate_mux(n350, n177, n15[2]);
  auto n355 = Bit::gate_nand(n162, n354);
  auto n367 = Bit::gate_nand(n163, n384);
  auto n378 = Bit::gate_nand(n187, n170);
  auto n406 = Bit::gate_xor(n379, n378);
  auto n382 = gate_mux(n380, n406, n383);
  auto n387 = Bit::gate_nand(n382, n381);
  auto n385 = gate_mux(n384, n390, n383);
  auto n386 = Bit::gate_nand(n15[0], n385);
  auto n401 = gate_mux(n416, n406, n15[0]);
  auto n402 = gate_mux(n401, n400, n15[1]);
  auto n404 = Bit::gate_not(n402);
  auto n409 = Bit::gate_not(n406);
  auto n167 = Bit::gate_and(n387, n386);
  auto n175 = Bit::gate_and(n383, n311);
  hash_out[0] = Bit::gate_and(n323, n313);
  auto n192 = Bit::gate_and(n207, n316);
  auto n198 = Bit::gate_and(n383, n335);
  auto n200 = Bit::gate_and(n175, n184);
  auto n201 = Bit::gate_and(n352, n351);
  auto n312 = Bit::gate_xor(n354, n200);
  hash_out[1] = Bit::gate_nand(n313, n312);
  auto n321 = Bit::gate_nand(n192, n320);
  auto n342 = Bit::gate_xor(n322, n321);
  auto n366 = Bit::gate_not(n342);
  auto n337 = gate_mux(n342, n323, n15[1]);
  auto n388 = gate_mux(n337, n198, n15[0]);
  auto n340 = Bit::gate_nand(n184, n388);
  auto n343 = Bit::gate_xor(n366, n340);
  auto n338 = Bit::gate_nand(n337, n15[0]);
  auto n403 = Bit::gate_nand(n339, n338);
  auto n356 = Bit::gate_nand(n184, n403);
  auto n360 = Bit::gate_xor(n384, n356);
  auto n341 = Bit::gate_not(n340);
  auto n345 = Bit::gate_nand(n342, n341);
  auto n353 = Bit::gate_nand(n163, n366);
  auto n357 = Bit::gate_not(n356);
  auto n362 = Bit::gate_nand(n358, n357);
  auto n368 = Bit::gate_nand(n162, n366);
  auto n370 = gate_mux(n369, n175, n15[2]);
  auto n389 = gate_mux(n167, n388, n15[2]);
  auto n407 = Bit::gate_nand(n185, n389);
  auto n411 = Bit::gate_xor(n406, n407);
  auto n405 = gate_mux(n404, n403, n15[2]);
  auto n415 = Bit::gate_nand(n185, n405);
  auto n408 = Bit::gate_not(n407);
  auto n413 = Bit::gate_nand(n409, n408);
  auto n178 = Bit::gate_and(n370, n185);
  auto n181 = Bit::gate_and(n185, n201);
  auto n197 = Bit::gate_and(n200, n335);
  auto n202 = Bit::gate_and(n368, n367);
  auto n203 = Bit::gate_and(n181, n353);
  hash_out[2] = Bit::gate_xor(n343, n197);
  auto n344 = Bit::gate_nand(n343, n197);
  auto n359 = Bit::gate_nand(n345, n344);
  hash_out[3] = Bit::gate_xor(n360, n359);
  auto n371 = Bit::gate_nand(n203, n355);
  auto n375 = Bit::gate_xor(n380, n371);
  auto n361 = Bit::gate_nand(n360, n359);
  auto n374 = Bit::gate_nand(n362, n361);
  hash_out[4] = Bit::gate_xor(n375, n374);
  auto n391 = Bit::gate_nand(n202, n178);
  auto n395 = Bit::gate_xor(n390, n391);
  auto n372 = Bit::gate_not(n371);
  auto n377 = Bit::gate_nand(n373, n372);
  auto n376 = Bit::gate_nand(n375, n374);
  auto n394 = Bit::gate_nand(n377, n376);
  hash_out[5] = Bit::gate_xor(n395, n394);
  auto n392 = Bit::gate_not(n391);
  auto n397 = Bit::gate_nand(n393, n392);
  auto n396 = Bit::gate_nand(n395, n394);
  auto n410 = Bit::gate_nand(n397, n396);
  hash_out[6] = Bit::gate_xor(n411, n410);
  auto n412 = Bit::gate_nand(n411, n410);
  auto n414 = Bit::gate_nand(n413, n412);
  auto n417 = Bit::gate_xor(n415, n414);
  hash_out[7] = Bit::gate_xor(n417, n416);
}
template<class T, class Bit> void jen_round
(T & hash_out, const T & hash_in, const T & key_value, const T & n10, const T & n6) noexcept
{
  auto n80 = Bit::gate_and(key_value[0], hash_in[0]);
  auto n91 = Bit::gate_not(n10[3]);
  auto n90 = Bit::gate_not(n10[7]);
  auto n93 = Bit::gate_not(n10[5]);
  auto n92 = Bit::gate_not(n10[4]);
  auto n94 = Bit::gate_not(n10[6]);
  auto n98 = Bit::gate_nand(hash_in[2], key_value[2]);
  auto n102 = Bit::gate_xor(hash_in[2], key_value[2]);
  auto n96 = Bit::gate_nand(hash_in[1], key_value[1]);
  auto n99 = Bit::gate_xor(hash_in[1], key_value[1]);
  auto n95 = Bit::gate_nand(n80, n99);
  auto n101 = Bit::gate_nand(n96, n95);
  auto n97 = Bit::gate_nand(n102, n101);
  auto n105 = Bit::gate_nand(n98, n97);
  auto n106 = Bit::gate_xor(hash_in[3], key_value[3]);
  auto n130 = Bit::gate_xor(n105, n106);
  auto n228 = Bit::gate_xor(n80, n99);
  auto n100 = gate_mux(n130, n228, n10[1]);
  auto n144 = Bit::gate_not(n10[0]);
  auto n104 = Bit::gate_nand(n100, n144);
  auto n244 = Bit::gate_xor(key_value[0], hash_in[0]);
  auto n220 = Bit::gate_xor(n102, n101);
  auto n141 = Bit::gate_not(n10[1]);
  auto n128 = gate_mux(n244, n220, n141);
  auto n103 = Bit::gate_nand(n128, n10[0]);
  auto n149 = Bit::gate_nand(n104, n103);
  auto n110 = Bit::gate_xor(hash_in[4], key_value[4]);
  auto n108 = Bit::gate_nand(hash_in[3], key_value[3]);
  auto n107 = Bit::gate_nand(n106, n105);
  auto n109 = Bit::gate_nand(n108, n107);
  auto n115 = Bit::gate_xor(hash_in[5], key_value[5]);
  auto n113 = Bit::gate_not(n115);
  auto n112 = Bit::gate_nand(hash_in[4], key_value[4]);
  auto n111 = Bit::gate_nand(n110, n109);
  auto n114 = Bit::gate_nand(n112, n111);
  auto n192 = Bit::gate_xor(n113, n114);
  auto n119 = Bit::gate_xor(hash_in[6], key_value[6]);
  auto n117 = Bit::gate_nand(hash_in[5], key_value[5]);
  auto n116 = Bit::gate_nand(n115, n114);
  auto n118 = Bit::gate_nand(n117, n116);
  auto n188 = Bit::gate_xor(n119, n118);
  auto n121 = Bit::gate_nand(n119, n118);
  auto n120 = Bit::gate_nand(hash_in[6], key_value[6]);
  auto n122 = Bit::gate_nand(n121, n120);
  auto n123 = Bit::gate_xor(hash_in[7], n122);
  auto n177 = Bit::gate_xor(key_value[7], n123);
  auto n124 = gate_mux(n188, n177, n144);
  auto n148 = Bit::gate_not(n10[2]);
  auto n170 = Bit::gate_not(n188);
  auto n208 = Bit::gate_not(n130);
  auto n131 = gate_mux(n192, n208, n10[1]);
  auto n132 = Bit::gate_nand(n10[0], n131);
  auto n135 = gate_mux(n244, n228, n144);
  auto n152 = Bit::gate_not(n220);
  auto n139 = gate_mux(n208, n152, n10[0]);
  auto n140 = Bit::gate_nand(n10[1], n139);
  auto n146 = Bit::gate_nand(n10[0], n208);
  auto n145 = gate_mux(n228, n220, n144);
  auto n245 = Bit::gate_not(n6[0]);
  auto n246 = Bit::gate_not(n6[1]);
  auto n180 = Bit::gate_not(n6[3]);
  auto n179 = Bit::gate_not(n6[4]);
  auto n182 = Bit::gate_not(n6[5]);
  auto n181 = Bit::gate_not(n6[6]);
  auto n183 = Bit::gate_not(n6[7]);
  auto n250 = Bit::gate_not(n6[2]);
  auto n59 = Bit::gate_xnor(n110, n109);
  auto n60 = Bit::gate_and(n245, n246);
  auto n62 = Bit::gate_and(n180, n179);
  auto n63 = Bit::gate_and(n182, n181);
  auto n66 = Bit::gate_and(n93, n92);
  auto n70 = Bit::gate_and(n91, n90);
  auto n73 = Bit::gate_and(n70, n66);
  auto n74 = Bit::gate_and(n6[0], n246);
  auto n75 = Bit::gate_and(n141, n144);
  auto n79 = Bit::gate_and(n244, n144);
  auto n86 = Bit::gate_and(n141, n135);
  auto n87 = Bit::gate_and(n228, n141);
  auto n88 = Bit::gate_and(n148, n145);
  auto n136 = gate_mux(n59, n192, n144);
  auto n125 = Bit::gate_not(n136);
  auto n126 = gate_mux(n125, n124, n141);
  auto n127 = gate_mux(n149, n126, n148);
  auto n150 = gate_mux(n87, n128, n144);
  auto n129 = gate_mux(n170, n59, n10[1]);
  auto n133 = Bit::gate_nand(n129, n144);
  auto n137 = Bit::gate_nand(n136, n141);
  auto n138 = gate_mux(n86, n137, n148);
  auto n142 = Bit::gate_nand(n75, n59);
  auto n143 = gate_mux(n79, n142, n148);
  auto n147 = gate_mux(n146, n88, n10[1]);
  auto n58 = Bit::gate_and(n62, n63);
  auto n64 = Bit::gate_and(n58, n183);
  auto n67 = Bit::gate_and(n73, n94);
  auto n68 = Bit::gate_and(n67, n138);
  auto n69 = Bit::gate_and(n67, n143);
  auto n77 = Bit::gate_and(n133, n132);
  auto n176 = Bit::gate_nand(n67, n127);
  auto n134 = gate_mux(n150, n77, n148);
  auto n172 = Bit::gate_nand(n67, n134);
  auto n186 = Bit::gate_not(n172);
  auto n164 = Bit::gate_nand(n68, n140);
  auto n159 = Bit::gate_nand(n69, n147);
  auto n199 = Bit::gate_not(n159);
  auto n191 = Bit::gate_not(n164);
  auto n193 = Bit::gate_xor(n192, n191);
  auto n61 = Bit::gate_and(n64, n250);
  auto n65 = Bit::gate_and(n67, n148);
  auto n89 = Bit::gate_and(n65, n150);
  auto n154 = Bit::gate_nand(n65, n149);
  auto n229 = Bit::gate_nand(n65, n86);
  auto n151 = Bit::gate_not(n229);
  auto n219 = Bit::gate_nand(n228, n151);
  auto n153 = Bit::gate_nand(n219, n152);
  auto n155 = Bit::gate_nand(n89, n153);
  auto n158 = Bit::gate_nand(n154, n155);
  auto n207 = Bit::gate_not(n154);
  auto n210 = Bit::gate_not(n155);
  auto n156 = Bit::gate_nand(n207, n210);
  auto n157 = Bit::gate_nand(n208, n156);
  auto n160 = Bit::gate_nand(n158, n157);
  auto n163 = Bit::gate_nand(n159, n160);
  auto n198 = Bit::gate_not(n160);
  auto n161 = Bit::gate_nand(n199, n198);
  auto n162 = Bit::gate_nand(n59, n161);
  auto n165 = Bit::gate_nand(n163, n162);
  auto n168 = Bit::gate_nand(n164, n165);
  auto n194 = Bit::gate_not(n165);
  auto n166 = Bit::gate_nand(n191, n194);
  auto n167 = Bit::gate_nand(n192, n166);
  auto n171 = Bit::gate_nand(n168, n167);
  auto n185 = Bit::gate_not(n171);
  auto n169 = Bit::gate_nand(n186, n185);
  auto n174 = Bit::gate_nand(n170, n169);
  auto n173 = Bit::gate_nand(n172, n171);
  auto n175 = Bit::gate_nand(n174, n173);
  auto n178 = Bit::gate_xor(n176, n175);
  auto n214 = Bit::gate_xor(n178, n177);
  auto n184 = Bit::gate_nand(n60, n61);
  auto n187 = Bit::gate_xor(n186, n185);
  auto n195 = Bit::gate_xor(n188, n187);
  auto n211 = Bit::gate_not(n195);
  auto n189 = gate_mux(n214, n195, n245);
  auto n222 = Bit::gate_xor(n194, n193);
  auto n196 = Bit::gate_not(n222);
  auto n203 = gate_mux(n214, n196, n246);
  auto n200 = Bit::gate_xor(n199, n198);
  auto n235 = Bit::gate_xor(n59, n200);
  auto n201 = gate_mux(n211, n235, n246);
  auto n202 = Bit::gate_not(n201);
  auto n205 = Bit::gate_nand(n202, n245);
  auto n204 = Bit::gate_nand(n6[0], n203);
  auto n252 = Bit::gate_nand(n205, n204);
  auto n206 = Bit::gate_nand(n61, n252);
  hash_out[4] = Bit::gate_xor(n235, n206);
  auto n209 = Bit::gate_xor(n208, n207);
  auto n233 = Bit::gate_xor(n210, n209);
  auto n212 = gate_mux(n222, n211, n6[0]);
  auto n217 = Bit::gate_nand(n6[1], n212);
  auto n213 = Bit::gate_nand(n74, n235);
  auto n215 = Bit::gate_nand(n60, n233);
  auto n221 = Bit::gate_xor(n220, n219);
  auto n236 = Bit::gate_xor(n89, n221);
  auto n223 = gate_mux(n235, n222, n6[0]);
  auto n226 = Bit::gate_nand(n6[1], n223);
  auto n248 = gate_mux(n236, n233, n6[0]);
  auto n224 = Bit::gate_nand(n248, n246);
  auto n232 = Bit::gate_xor(n229, n228);
  auto n243 = Bit::gate_nand(n65, n75);
  auto n230 = Bit::gate_not(n243);
  auto n231 = Bit::gate_nand(n244, n230);
  auto n237 = gate_mux(n236, n235, n6[1]);
  auto n238 = Bit::gate_nand(n6[0], n237);
  auto n255 = Bit::gate_nand(n244, n243);
  auto n71 = Bit::gate_and(n64, n213);
  auto n81 = Bit::gate_and(n195, n246);
  auto n82 = Bit::gate_and(n60, n214);
  auto n83 = Bit::gate_and(n246, n189);
  hash_out[7] = Bit::gate_and(n214, n184);
  auto n85 = Bit::gate_and(n232, n231);
  auto n190 = Bit::gate_nand(n83, n61);
  hash_out[6] = Bit::gate_xor(n211, n190);
  auto n240 = gate_mux(n81, n203, n245);
  auto n197 = Bit::gate_nand(n61, n240);
  hash_out[5] = Bit::gate_xor(n222, n197);
  auto n216 = gate_mux(n82, n215, n250);
  auto n225 = gate_mux(n83, n224, n250);
  auto n234 = gate_mux(n85, n233, n6[1]);
  auto n239 = Bit::gate_nand(n234, n245);
  auto n247 = gate_mux(n85, n255, n245);
  auto n249 = gate_mux(n248, n247, n246);
  auto n251 = Bit::gate_not(n249);
  auto n253 = gate_mux(n252, n251, n250);
  auto n254 = Bit::gate_nand(n64, n253);
  hash_out[0] = Bit::gate_xor(n255, n254);
  auto n72 = Bit::gate_and(n64, n225);
  auto n76 = Bit::gate_and(n71, n216);
  auto n78 = Bit::gate_and(n239, n238);
  auto n218 = Bit::gate_nand(n217, n76);
  hash_out[3] = Bit::gate_xor(n233, n218);
  auto n227 = Bit::gate_nand(n226, n72);
  hash_out[2] = Bit::gate_xor(n236, n227);
  auto n241 = gate_mux(n240, n78, n250);
  auto n242 = Bit::gate_nand(n241, n64);
  hash_out[1] = Bit::gate_xor(n85, n242);
}
template<class T, class Bit> void matrix_round
(T & c_out, const T & a, const T & b, const T & c_in) noexcept
{
  auto n3 = Bit::gate_and(b[0], a[0]);
  auto n4 = Bit::gate_and(a[2], b[1]);
  c_out[0] = Bit::gate_xor(n3, c_in[0]);
  auto n10 = Bit::gate_nand(n3, c_in[0]);
  auto n5 = Bit::gate_nand(b[1], a[0]);
  auto n9 = Bit::gate_xor(c_in[1], n5);
  auto n8 = Bit::gate_nand(b[0], a[1]);
  auto n11 = Bit::gate_xor(n9, n8);
  auto n6 = Bit::gate_not(n5);
  auto n19 = Bit::gate_nand(n6, c_in[1]);
  auto n18 = Bit::gate_nand(a[2], b[0]);
  auto n20 = Bit::gate_nand(b[1], a[1]);
  auto n7 = Bit::gate_xor(n18, n20);
  auto n28 = Bit::gate_xor(n19, n7);
  auto n14 = Bit::gate_not(n28);
  auto n13 = Bit::gate_nand(n9, n8);
  auto n12 = Bit::gate_nand(n11, n10);
  auto n27 = Bit::gate_nand(n13, n12);
  auto n23 = Bit::gate_nand(a[0], b[2]);
  auto n26 = Bit::gate_xor(c_in[2], n23);
  auto n29 = Bit::gate_xor(n27, n26);
  c_out[2] = Bit::gate_xor(n14, n29);
  auto n43 = Bit::gate_xor(c_in[3], n4);
  auto n41 = Bit::gate_not(n43);
  auto n16 = Bit::gate_not(n20);
  auto n15 = Bit::gate_not(n19);
  auto n17 = Bit::gate_nand(n16, n15);
  auto n22 = Bit::gate_nand(n18, n17);
  auto n21 = Bit::gate_nand(n20, n19);
  auto n46 = Bit::gate_nand(n22, n21);
  auto n24 = Bit::gate_not(n23);
  auto n42 = Bit::gate_nand(n24, c_in[2]);
  auto n25 = Bit::gate_xor(n46, n42);
  auto n38 = Bit::gate_xor(n41, n25);
  auto n51 = Bit::gate_nand(b[0], a[3]);
  auto n50 = Bit::gate_nand(a[1], b[2]);
  auto n49 = Bit::gate_nand(b[3], a[0]);
  auto n52 = Bit::gate_xor(n50, n49);
  auto n33 = Bit::gate_xor(n51, n52);
  auto n35 = Bit::gate_not(n33);
  auto n31 = Bit::gate_nand(n27, n26);
  auto n30 = Bit::gate_nand(n29, n28);
  auto n34 = Bit::gate_nand(n31, n30);
  auto n32 = Bit::gate_xor(n35, n34);
  c_out[3] = Bit::gate_xor(n38, n32);
  auto n40 = Bit::gate_nand(n33, n34);
  auto n36 = Bit::gate_not(n34);
  auto n37 = Bit::gate_nand(n36, n35);
  auto n39 = Bit::gate_nand(n38, n37);
  auto n60 = Bit::gate_nand(n40, n39);
  auto n48 = Bit::gate_nand(n42, n41);
  auto n44 = Bit::gate_not(n42);
  auto n45 = Bit::gate_nand(n44, n43);
  auto n47 = Bit::gate_nand(n46, n45);
  auto n59 = Bit::gate_nand(n48, n47);
  auto n62 = Bit::gate_xor(n60, n59);
  auto n58 = Bit::gate_not(n62);
  auto n54 = Bit::gate_nand(n50, n49);
  auto n53 = Bit::gate_nand(n52, n51);
  auto n87 = Bit::gate_nand(n54, n53);
  auto n83 = Bit::gate_nand(b[1], a[3]);
  auto n74 = Bit::gate_xor(n83, c_in[4]);
  auto n78 = Bit::gate_nand(n4, c_in[3]);
  auto n73 = Bit::gate_nand(b[0], a[4]);
  auto n55 = Bit::gate_xor(n78, n73);
  auto n91 = Bit::gate_xor(n74, n55);
  auto n65 = Bit::gate_nand(a[2], b[2]);
  auto n67 = Bit::gate_not(n65);
  auto n70 = Bit::gate_nand(b[3], a[1]);
  auto n66 = Bit::gate_nand(b[4], a[0]);
  auto n56 = Bit::gate_xor(n70, n66);
  auto n89 = Bit::gate_xor(n67, n56);
  auto n86 = Bit::gate_not(n89);
  auto n57 = Bit::gate_xor(n91, n86);
  auto n61 = Bit::gate_xor(n87, n57);
  c_out[4] = Bit::gate_xor(n58, n61);
  auto n64 = Bit::gate_nand(n60, n59);
  auto n63 = Bit::gate_nand(n62, n61);
  auto n125 = Bit::gate_nand(n64, n63);
  auto n72 = Bit::gate_nand(n66, n65);
  auto n68 = Bit::gate_not(n66);
  auto n69 = Bit::gate_nand(n68, n67);
  auto n71 = Bit::gate_nand(n70, n69);
  auto n115 = Bit::gate_nand(n72, n71);
  auto n117 = Bit::gate_not(n115);
  auto n105 = Bit::gate_nand(b[1], a[4]);
  auto n116 = Bit::gate_xor(n105, c_in[5]);
  auto n118 = Bit::gate_not(n116);
  auto n80 = Bit::gate_nand(n73, n74);
  auto n76 = Bit::gate_not(n73);
  auto n75 = Bit::gate_not(n74);
  auto n77 = Bit::gate_nand(n76, n75);
  auto n79 = Bit::gate_nand(n78, n77);
  auto n120 = Bit::gate_nand(n80, n79);
  auto n81 = Bit::gate_xor(n118, n120);
  auto n124 = Bit::gate_xor(n117, n81);
  auto n127 = Bit::gate_not(n124);
  auto n96 = Bit::gate_nand(b[0], a[5]);
  auto n98 = Bit::gate_not(n96);
  auto n101 = Bit::gate_nand(a[1], b[4]);
  auto n97 = Bit::gate_nand(a[0], b[5]);
  auto n82 = Bit::gate_xor(n101, n97);
  auto n110 = Bit::gate_xor(n98, n82);
  auto n134 = Bit::gate_nand(a[2], b[3]);
  auto n136 = Bit::gate_not(n134);
  auto n84 = Bit::gate_not(n83);
  auto n135 = Bit::gate_nand(n84, c_in[4]);
  auto n139 = Bit::gate_nand(a[3], b[2]);
  auto n85 = Bit::gate_xor(n135, n139);
  auto n109 = Bit::gate_xor(n136, n85);
  auto n94 = Bit::gate_xor(n110, n109);
  auto n93 = Bit::gate_nand(n86, n87);
  auto n88 = Bit::gate_not(n87);
  auto n90 = Bit::gate_nand(n89, n88);
  auto n92 = Bit::gate_nand(n91, n90);
  auto n112 = Bit::gate_nand(n93, n92);
  auto n129 = Bit::gate_xor(n94, n112);
  auto n95 = Bit::gate_xor(n127, n129);
  c_out[5] = Bit::gate_xor(n125, n95);
  auto n103 = Bit::gate_nand(n97, n96);
  auto n99 = Bit::gate_not(n97);
  auto n100 = Bit::gate_nand(n99, n98);
  auto n102 = Bit::gate_nand(n101, n100);
  auto n198 = Bit::gate_nand(n103, n102);
  auto n104 = Bit::gate_nand(a[5], b[1]);
  auto n196 = Bit::gate_xor(c_in[6], n104);
  auto n106 = Bit::gate_not(n105);
  auto n197 = Bit::gate_nand(n106, c_in[5]);
  auto n199 = Bit::gate_xor(n196, n197);
  auto n178 = Bit::gate_xor(n198, n199);
  auto n108 = Bit::gate_not(n110);
  auto n107 = Bit::gate_not(n109);
  auto n114 = Bit::gate_nand(n108, n107);
  auto n111 = Bit::gate_nand(n110, n109);
  auto n113 = Bit::gate_nand(n112, n111);
  auto n176 = Bit::gate_nand(n114, n113);
  auto n122 = Bit::gate_nand(n116, n115);
  auto n119 = Bit::gate_nand(n118, n117);
  auto n121 = Bit::gate_nand(n120, n119);
  auto n177 = Bit::gate_nand(n122, n121);
  auto n123 = Bit::gate_xor(n176, n177);
  auto n206 = Bit::gate_xor(n178, n123);
  auto n143 = Bit::gate_not(n206);
  auto n131 = Bit::gate_nand(n124, n125);
  auto n126 = Bit::gate_not(n125);
  auto n128 = Bit::gate_nand(n127, n126);
  auto n130 = Bit::gate_nand(n129, n128);
  auto n209 = Bit::gate_nand(n131, n130);
  auto n187 = Bit::gate_nand(a[0], b[6]);
  auto n191 = Bit::gate_nand(a[1], b[5]);
  auto n186 = Bit::gate_nand(a[4], b[2]);
  auto n132 = Bit::gate_xor(n191, n186);
  auto n148 = Bit::gate_xor(n187, n132);
  auto n155 = Bit::gate_nand(b[0], a[6]);
  auto n157 = Bit::gate_not(n155);
  auto n160 = Bit::gate_nand(a[3], b[3]);
  auto n156 = Bit::gate_nand(a[2], b[4]);
  auto n133 = Bit::gate_xor(n160, n156);
  auto n147 = Bit::gate_xor(n157, n133);
  auto n141 = Bit::gate_nand(n135, n134);
  auto n137 = Bit::gate_not(n135);
  auto n138 = Bit::gate_nand(n137, n136);
  auto n140 = Bit::gate_nand(n139, n138);
  auto n144 = Bit::gate_nand(n141, n140);
  auto n146 = Bit::gate_not(n144);
  auto n142 = Bit::gate_xor(n147, n146);
  auto n208 = Bit::gate_xor(n148, n142);
  auto n207 = Bit::gate_xor(n209, n208);
  c_out[6] = Bit::gate_xor(n143, n207);
  auto n145 = Bit::gate_not(n147);
  auto n151 = Bit::gate_nand(n145, n144);
  auto n149 = Bit::gate_nand(n147, n146);
  auto n150 = Bit::gate_nand(n149, n148);
  auto n154 = Bit::gate_nand(n151, n150);
  auto n152 = Bit::gate_nand(a[5], c_in[6]);
  auto n162 = Bit::gate_nand(n156, n155);
  auto n158 = Bit::gate_not(n156);
  auto n159 = Bit::gate_nand(n158, n157);
  auto n161 = Bit::gate_nand(n160, n159);
  auto n163 = Bit::gate_nand(n162, n161);
  auto n166 = Bit::gate_nand(b[4], a[3]);
  auto n165 = Bit::gate_nand(a[7], b[0]);
  auto n170 = Bit::gate_xor(n166, n165);
  auto n168 = Bit::gate_nand(b[3], a[4]);
  auto n167 = Bit::gate_nand(b[5], a[2]);
  auto n169 = Bit::gate_xor(n168, n167);
  auto n171 = Bit::gate_xor(n170, n169);
  auto n174 = Bit::gate_not(n177);
  auto n173 = Bit::gate_not(n178);
  auto n175 = Bit::gate_nand(n174, n173);
  auto n180 = Bit::gate_nand(n176, n175);
  auto n179 = Bit::gate_nand(n178, n177);
  auto n181 = Bit::gate_nand(n180, n179);
  auto n183 = Bit::gate_nand(b[6], a[1]);
  auto n205 = Bit::gate_xor(c_in[7], n183);
  auto n185 = Bit::gate_nand(a[5], b[2]);
  auto n184 = Bit::gate_nand(b[7], a[0]);
  auto n195 = Bit::gate_xor(n185, n184);
  auto n193 = Bit::gate_nand(n186, n187);
  auto n189 = Bit::gate_not(n186);
  auto n188 = Bit::gate_not(n187);
  auto n190 = Bit::gate_nand(n189, n188);
  auto n192 = Bit::gate_nand(n191, n190);
  auto n194 = Bit::gate_nand(n193, n192);
  auto n203 = Bit::gate_xor(n195, n194);
  auto n201 = Bit::gate_nand(n197, n196);
  auto n200 = Bit::gate_nand(n199, n198);
  auto n202 = Bit::gate_nand(n201, n200);
  auto n204 = Bit::gate_xor(n203, n202);
  auto n213 = Bit::gate_xor(n205, n204);
  auto n211 = Bit::gate_nand(n207, n206);
  auto n210 = Bit::gate_nand(n209, n208);
  auto n212 = Bit::gate_nand(n211, n210);
  auto n214 = Bit::gate_xor(n213, n212);
  auto n1 = Bit::gate_xnor(a[6], n152);
  c_out[1] = Bit::gate_xnor(n10, n11);
  auto n153 = Bit::gate_nand(b[1], n1);
  auto n164 = Bit::gate_xor(n154, n153);
  auto n172 = Bit::gate_xor(n164, n163);
  auto n182 = Bit::gate_xor(n172, n171);
  auto n215 = Bit::gate_xor(n182, n181);
  c_out[7] = Bit::gate_xor(n215, n214);
}
template<class T, class Bit> void sieve_round
(T & y, const T & a, const T & b) noexcept
{
  y[7] = Bit::gate_and(a[0], b[7]);
  y[6] = Bit::gate_and(a[0], b[6]);
  y[5] = Bit::gate_and(a[0], b[5]);
  y[4] = Bit::gate_and(a[0], b[4]);
  y[3] = Bit::gate_and(a[0], b[3]);
  y[2] = Bit::gate_and(a[0], b[2]);
  y[1] = Bit::gate_and(a[0], b[1]);
  y[0] = Bit::gate_and(a[0], b[0]);
}
template<class T, class Bit> void speck_round
(T & x_out, T & y_out, const T & x_in, const T & y_in, const T & k) noexcept
{
  auto n10 = Bit::gate_and(x_in[7], y_in[0]);
  auto n12 = Bit::gate_xor(y_in[1], x_in[0]);
  auto n11 = Bit::gate_xor(n12, n10);
  x_out[1] = Bit::gate_xor(k[1], n11);
  y_out[1] = Bit::gate_xor(y_in[7], x_out[1]);
  auto n14 = Bit::gate_nand(y_in[1], x_in[0]);
  auto n13 = Bit::gate_nand(n12, n10);
  auto n16 = Bit::gate_nand(n14, n13);
  auto n17 = Bit::gate_xor(y_in[2], x_in[1]);
  auto n15 = Bit::gate_xor(n17, k[2]);
  x_out[2] = Bit::gate_xor(n16, n15);
  y_out[2] = Bit::gate_xor(y_in[0], x_out[2]);
  auto n23 = Bit::gate_nand(y_in[4], x_in[3]);
  auto n28 = Bit::gate_xor(y_in[4], x_in[3]);
  auto n21 = Bit::gate_nand(y_in[3], x_in[2]);
  auto n25 = Bit::gate_xor(y_in[3], x_in[2]);
  auto n19 = Bit::gate_nand(y_in[2], x_in[1]);
  auto n18 = Bit::gate_nand(n17, n16);
  auto n27 = Bit::gate_nand(n19, n18);
  auto n20 = Bit::gate_nand(n25, n27);
  auto n30 = Bit::gate_nand(n21, n20);
  auto n22 = Bit::gate_nand(n28, n30);
  auto n31 = Bit::gate_nand(n23, n22);
  auto n32 = Bit::gate_xor(y_in[5], x_in[4]);
  auto n24 = Bit::gate_xor(n32, k[5]);
  x_out[5] = Bit::gate_xor(n31, n24);
  y_out[5] = Bit::gate_xor(y_in[3], x_out[5]);
  auto n26 = Bit::gate_xor(n25, k[3]);
  x_out[3] = Bit::gate_xor(n27, n26);
  y_out[3] = Bit::gate_xor(y_in[1], x_out[3]);
  auto n29 = Bit::gate_xor(n28, k[4]);
  x_out[4] = Bit::gate_xor(n30, n29);
  y_out[4] = Bit::gate_xor(y_in[2], x_out[4]);
  auto n34 = Bit::gate_nand(y_in[5], x_in[4]);
  auto n33 = Bit::gate_nand(n32, n31);
  auto n37 = Bit::gate_nand(n34, n33);
  auto n38 = Bit::gate_xor(y_in[6], x_in[5]);
  auto n35 = Bit::gate_xor(k[6], n38);
  x_out[6] = Bit::gate_xor(n37, n35);
  y_out[6] = Bit::gate_xor(y_in[4], x_out[6]);
  auto n36 = Bit::gate_xor(x_in[7], y_in[0]);
  x_out[0] = Bit::gate_xor(k[0], n36);
  y_out[0] = Bit::gate_xor(y_in[6], x_out[0]);
  auto n40 = Bit::gate_nand(y_in[6], x_in[5]);
  auto n39 = Bit::gate_nand(n38, n37);
  auto n41 = Bit::gate_nand(n40, n39);
  auto n43 = Bit::gate_xor(x_in[6], n41);
  auto n42 = Bit::gate_xor(y_in[7], k[7]);
  x_out[7] = Bit::gate_xor(n43, n42);
  y_out[7] = Bit::gate_xor(y_in[5], x_out[7]);
}
